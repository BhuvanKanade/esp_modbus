## main/Kconfig.projbuild
```kconfig
menu "Example Configuration"

    config BLINK_GPIO
        int "Blink GPIO number"
        range 0 34
        default 5
        help
            GPIO number (IOxx) to blink on and off.

            Some GPIOs are used for other purposes (flash connections, etc.) and cannot be used to blink.

            GPIOs 35-39 are input-only so cannot be used as outputs.


    config BLINK_LED_RATE
        int "Blink LED Rate"
        range 10 5000
        default 1000
        help
            LED Blink rate number to blink on and off.

            Value is in milli Seconds rangng from 10mS to 5Sec
            
endmenu
```
